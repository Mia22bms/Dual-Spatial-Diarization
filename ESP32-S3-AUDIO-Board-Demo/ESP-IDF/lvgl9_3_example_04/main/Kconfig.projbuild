## ESP32-S3-AUDIO-Board-Demo/ESP-IDF/lvgl9_3_example_04/main/Kconfig.projbuild
```kconfig
menu "LCD Configuration"
    choice LCD_MODULE
        prompt "LCD Module"
        default WAVESHARE_2INCH_TOUCH_LCD
        help
            Select the corresponding Waveshare LCD Module for your board.
            - 1.47inch Touch LCD(default)
            - 2inch Touch LCD
            - 2.8inch Touch LCD 
            - 3.5inch Touch LCD
    config WAVESHARE_1_47INCH_TOUCH_LCD
        bool "1.47inch Touch LCD"
        help
            https://www.waveshare.net/shop/1.47inch-Touch-LCD.htm
    config WAVESHARE_2INCH_TOUCH_LCD
        bool "2inch Touch LCD"
        help
            https://www.waveshare.net/shop/2.8inch-Capacitive-Touch-LCD.htm
    config WAVESHARE_2_8INCH_TOUCH_LCD
        bool "2.8inch Touch LCD"
        help
            https://www.waveshare.net/shop/2.8inch-Capacitive-Touch-LCD.htm
    config WAVESHARE_3_5INCH_TOUCH_LCD
        bool "3.5inch Touch LCD"
        help
            https://www.waveshare.net/shop/3.5inch-Capacitive-Touch-LCD.htm 
    endchoice

    choice DISPLAY_ROTATION_ANGLE
        prompt "Display Angle"
        default EXAMPLE_DISPLAY_ROTATION_90_DEGREE
        help
            Set the screen rotation Angle(On by default).
    
    config EXAMPLE_DISPLAY_ROTATION_0_DEGREE    
        bool "Set the screen to rotate 0 degrees"
        help
            Set the screen to rotate 0 degrees
    config EXAMPLE_DISPLAY_ROTATION_90_DEGREE    
        bool "Set the screen to rotate 90 degrees"
        help
            Set the screen to rotate 90 degrees 
    config EXAMPLE_DISPLAY_ROTATION_180_DEGREE  
        bool "Set the screen to rotate 180 degrees"
        help
            Set the screen to rotate 180 degrees 
    config EXAMPLE_DISPLAY_ROTATION_270_DEGREE  
        bool "Set the screen to rotate 270 degrees"
        help
            Set the screen to rotate 270 degrees
    endchoice
endmenu
```
